## config/west.yml
```yaml
manifest:
  remotes:
      # zmk official
    - name: zmkfirmware
      url-base: https://github.com/zmkfirmware
    - name: exedox                         #new entry
      url-base: https://github.com/exedox  #new entry
  projects:
    - name: zmk
      remote: zmkfirmware
      revision: v0.3
      import: app/west.yml
    - name: nice-view-zinogre                 #new entry
      remote: exedox                       #new entry
      revision: part                      #new entry
  self:
    path: config
```
